## examples/blink/Kconfig
```kconfig
mainmenu "AVR-IOE blink configuration"

# We need CONFIG_IOPORTS, but we don't care about anything else.
config BLINK_DEFAULTS
	bool
	default y
	select CONFIG_IOPORTS

source "../../ioe.Kconfig"
```

## examples/spiblink/master/Kconfig
```kconfig
mainmenu "AVR-IOE spiblink master configuration"

# We need CONFIG_IOPORTS, but we don't care about anything else.
config SPIBLINK_MASTER_DEFAULTS
	bool
	default y
	select CONFIG_SPI
	select CONFIG_IOPORTS

config CONFIG_BUTTON_IO
	string "Input pin used to connect button"
	depends on SPIBLINK_MASTER_DEFAULTS
	default "IO_C1"

config CONFIG_LED_IO
	string "Output pin used to connect test led"
	depends on SPIBLINK_MASTER_DEFAULTS
	default "IO_B0"

source "../../../ioe.Kconfig"
```

## examples/spiblink/slave/Kconfig
```kconfig
mainmenu "AVR-IOE spiblink slave configuration"

# We need CONFIG_IOPORTS, but we don't care about anything else.
config SPIBLINK_SLAVE_DEFAULTS
	bool
	default y
	select CONFIG_SPI
	select CONFIG_IOPORTS

config CONFIG_BLINK_IO
	string "Output pin used to connect led"
	depends on SPIBLINK_SLAVE_DEFAULTS
	default "IO_B0"

source "../../../ioe.Kconfig"
```

## examples/usartecho/Kconfig
```kconfig
mainmenu "AVR-IOE usartecho configuration"

# We need CONFIG_IOPORTS, but we don't care about anything else.
config USART_ECHO_DEFAULTS
	bool
	default y
	select CONFIG_USART
	select CONFIG_USART_OUTPUT_BUFFER
	depends on ! CONFIG_USART_INPUT_BUFFER

source "../../ioe.Kconfig"
```

## include/mcu/Kconfig
```kconfig
config MMCU
    string
    default "atmega328p" if ATMEGA328P
    default "attiny85" if ATTINY85
    default "attiny4313" if ATTINY4313
    
choice MCU
    prompt "Microcontroller (MMCU)"

source "$IOEROOT/include/mcu/atmega328p.Kconfig"
source "$IOEROOT/include/mcu/attiny85.Kconfig"
source "$IOEROOT/include/mcu/attiny4313.Kconfig"

endchoice
```
